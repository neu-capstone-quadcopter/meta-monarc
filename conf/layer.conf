## conf/layer.conf
```bitbake
BBPATH .= ":${LAYERDIR}"
BBFILES += "${LAYERDIR}/recipes-*/*.bb ${LAYERDIR}/recipes-*/*.bbappend"

BBFILE_COLLECTIONS += "monarc-layer"
BBFILE_PATTERN_monarc-layer := "^${LAYERDIR}/"
BBFILE_PRIORITY_monarc-layer = "100"

IMAGE_INSTALL += " \
    packagegroup-ros-comm \
    packagegroup-ros-world \
    monarc-uart-driver \
    monarc-tf \
    monarc-path-finder \
    protobuf \
    tmux \
    vim \
    gdb \
"
```
